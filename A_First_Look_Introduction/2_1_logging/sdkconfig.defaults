## A_First_Look_Introduction/2_1_logging/sdkconfig.defaults
```kconfig
#
# Log output
#
# CONFIG_LOG_DEFAULT_LEVEL_NONE is not set
# CONFIG_LOG_DEFAULT_LEVEL_ERROR is not set
# CONFIG_LOG_DEFAULT_LEVEL_WARN is not set
# CONFIG_LOG_DEFAULT_LEVEL_INFO is not set
# CONFIG_LOG_DEFAULT_LEVEL_DEBUG is not set
CONFIG_LOG_DEFAULT_LEVEL_VERBOSE=y
CONFIG_LOG_DEFAULT_LEVEL=3
```

## I2C_SPI_UART/11_1_remote_logging/sdkconfig.defaults
```kconfig
# CONFIG_ESP_CONSOLE_UART_DEFAULT is not set
CONFIG_ESP_CONSOLE_UART_CUSTOM=y
# CONFIG_ESP_CONSOLE_NONE is not set
CONFIG_ESP_CONSOLE_UART=y
CONFIG_ESP_CONSOLE_MULTIPLE_UART=y
# CONFIG_ESP_CONSOLE_UART_CUSTOM_NUM_0 is not set
CONFIG_ESP_CONSOLE_UART_CUSTOM_NUM_1=y
CONFIG_ESP_CONSOLE_UART_NUM=1
CONFIG_ESP_CONSOLE_UART_TX_GPIO=21
CONFIG_ESP_CONSOLE_UART_RX_GPIO=19
CONFIG_ESP_CONSOLE_UART_BAUDRATE=9600
CONFIG_ESPTOOLPY_MONITOR_BAUD_9600B=y
CONFIG_ESPTOOLPY_MONITOR_BAUD=9600
```

## I2C_SPI_UART/11_8_spi_sdd1306/sdkconfig.defaults
```kconfig
#
# Compiler options (neccesary for the library u8g2)
#
CONFIG_COMPILER_DISABLE_GCC8_WARNINGS=y
# end of Compiler options
```

## Internet_Server/15_4_web_socket/sdkconfig.defaults
```kconfig
#
# HTTP Server
#
CONFIG_HTTPD_MAX_REQ_HDR_LEN=1024
CONFIG_HTTPD_MAX_URI_LEN=512
CONFIG_HTTPD_ERR_RESP_NO_DELAY=y
CONFIG_HTTPD_PURGE_BUF_LEN=32
# CONFIG_HTTPD_LOG_PURGE_DATA is not set
CONFIG_HTTPD_WS_SUPPORT=y
# end of HTTP Server
```
